## sdkconfig.defaults
```kconfig
CONFIG_COMPILER_CXX_EXCEPTIONS=n
CONFIG_ESP_MAIN_TASK_STACK_SIZE=4096
CONFIG_LWIP_SO_RCVBUF=y
CONFIG_LOG_DEFAULT_LEVEL_INFO=y
CONFIG_FREERTOS_HZ=100

# CONFIG_FACTORY_RTC_SQW_CORRELATION_TRACE is not set
CONFIG_FACTORY_RX_BOUNDARY_TRACE=y

# Marker-gap diagnostic build: raw per-task cumulative run-time counters.
CONFIG_FREERTOS_USE_TRACE_FACILITY=y
CONFIG_FREERTOS_GENERATE_RUN_TIME_STATS=y
CONFIG_FREERTOS_RUN_TIME_STATS_USING_ESP_TIMER=y

CONFIG_ESP_TIMER_SUPPORTS_ISR_DISPATCH_METHOD=y
```

## sdkconfig.defaults.esp01
```kconfig
CONFIG_FACTORY_WIFI_SSID="AP-8300_2.4G"
CONFIG_FACTORY_WIFI_PASSWORD="MasterTI24$"
CONFIG_FACTORY_DEVICE_ID="ESP01"
CONFIG_ESP_CONSOLE_UART_DEFAULT=y
CONFIG_ESP_CONSOLE_UART=y
CONFIG_ESP_CONSOLE_UART_NUM=0
CONFIG_ESP_CONSOLE_UART_BAUDRATE=115200
```

## sdkconfig.defaults.esp02
```kconfig
CONFIG_FACTORY_WIFI_SSID="AP-8300_2.4G_EXT"
CONFIG_FACTORY_WIFI_PASSWORD="MasterTI24$"
CONFIG_FACTORY_DEVICE_ID="ESP02"
CONFIG_ESP_CONSOLE_UART_DEFAULT=y
CONFIG_ESP_CONSOLE_UART=y
CONFIG_ESP_CONSOLE_UART_NUM=0
CONFIG_ESP_CONSOLE_UART_BAUDRATE=115200
```
