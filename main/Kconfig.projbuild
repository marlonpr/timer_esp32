## main/Kconfig.projbuild
```kconfig
menu "Factory timer configuration"

config FACTORY_WIFI_SSID
    string "Wi-Fi SSID"
    default ""
    help
        SSID used by this timer in Wi-Fi station mode.

config FACTORY_WIFI_PASSWORD
    string "Wi-Fi password"
    default ""
    help
        WPA/WPA2/WPA3 password. Leave empty only for an open test network.

config FACTORY_DEVICE_ID
    string "Timer device ID"
    default "ESP01"
    help
        Uppercase protocol identifier. For the fleet test use ESP01 through ESP05.
        The protocol supports extending the same naming convention through ESP15.

config FACTORY_DEBUG_LOGS
    bool "Enable verbose factory timer protocol logs"
    default n
    help
        Compile detailed FCT1 packet, peer, acknowledgement, duplicate, and
        heartbeat logging into the firmware. Leave disabled for normal use.

config FACTORY_START_EDGE_DIAGNOSTICS
    bool "Enable physical START-edge diagnostic GPIO"
    default y
    help
        Drives a GPIO high at the real scheduler START transition and low when
        the timer is re-armed/reset. Use only for timing validation.

config FACTORY_START_EDGE_GPIO
    int "Physical START-edge diagnostic GPIO"
    range 0 48
    default 32 if IDF_TARGET_ESP32
    default 18 if IDF_TARGET_ESP32S3
    default 32
    depends on FACTORY_START_EDGE_DIAGNOSTICS
    help
        GPIO connected to the external/ESP32 logic analyzer. GPIO21/22 are
        reserved for the DS3231 I2C bus in the disciplined-timing pilot.

config FACTORY_START_TASK_TEST_DELAY_US
    int "Qualification-only delay of the START task (microseconds)"
    range 0 2000
    default 0
    help
        Delays the START state transition after the scheduler reaches T*.
        Interrupts remain enabled and the independent display COMMIT schedule
        remains anchored to armed T*. Use 500 for the late-start epoch regression;
        STARTED/StartError reports the actual delay. Normal fleet builds use 0.

endmenu

menu "Factory DS3231 disciplined timing"

config FACTORY_DS3231_DISCIPLINE
    bool "Enable DS3231 1 Hz disciplined countdown timing"
    default y
    help
        Uses the DS3231 INT/SQW 1 Hz output to continuously estimate the local
        ESP timer rate. Network synchronization and the existing START deadline
        path remain unchanged; only elapsed countdown time after START is
        disciplined.

config FACTORY_DS3231_SQW_GPIO
    int "DS3231 INT/SQW input GPIO"
    range 0 48
    default 27
    depends on FACTORY_DS3231_DISCIPLINE
    help
        Connect DS3231 INT/SQW to this GPIO. GPIO27 is unused by both current
        HUB75 target pin maps and matches the validated ESP01 pilot wiring.
        DS3231 SDA is fixed at GPIO21 and SCL at GPIO22.

config FACTORY_RTC_QUAL_LOGS
    bool "Enable DS3231 qualification logs"
    default y
    depends on FACTORY_DS3231_DISCIPLINE
    help
        Emits machine-readable RTC_QUAL, RTC_SYNC_QUAL and RTC_START_QUAL
        records for relative RTC-rate qualification. These diagnostics do not
        change clock discipline, ARM, START, or countdown behavior.

config FACTORY_RTC_QUAL_LOG_INTERVAL_S
    int "RTC qualification sample interval (seconds)"
    range 1 3600
    default 16
    depends on FACTORY_RTC_QUAL_LOGS
    help
        Fixed cadence for RTC_QUAL estimator samples. 16 seconds gives eight
        samples per 128-second regression window while keeping UART traffic low.

config FACTORY_RTC_SQW_CORRELATION_TRACE
    bool "Buffer raw SQW ISR timestamps"
    default n
    depends on FACTORY_DS3231_DISCIPLINE
    help
        Diagnostic-only ring buffer. Disabled in the v6.18-A validation build so
        there is no SQW ISR ring-buffer critical section or trace write. Enable
        only for dedicated instrumentation runs.


config FACTORY_RTC_FIT_RESIDUAL_REJECTION
    bool "Reject isolated late SQW timestamp outliers from the rate fit"
    default y
    depends on FACTORY_DS3231_DISCIPLINE
    help
        Keeps a physically accepted 1-Hz edge for liveness/sequence accounting but
        excludes its timestamp from the rate regression only when adjacent intervals
        show the directional +d/-d signature of an isolated late ESP-side timestamp.
        The opposite -d/+d (apparently early center) signature is retained because ISR
        latency cannot timestamp a physical edge early and rejecting it can capture a
        fit that was pulled late by neighboring delayed timestamps. This does not alter
        START scheduling.

config FACTORY_RTC_FIT_RESIDUAL_THRESHOLD_US
    int "SQW fit timestamp residual threshold (microseconds)"
    range 2 50
    default 4
    depends on FACTORY_RTC_FIT_RESIDUAL_REJECTION
    help
        Minimum directional residual required on both adjacent intervals before a
        late shared center timestamp is excluded from the regression. The first
        interval must be >= +threshold and the second <= -threshold. The validated
        DS3231 physical edge noise is far below this threshold.

config FACTORY_RX_BOUNDARY_TRACE
    bool "Trace control-port RX near display boundaries"
    default y
    help
        Timestamps UDP packets received on the factory control port and queues a
        low-priority diagnostic record when a packet arrives in the final 15 ms
        before a running countdown boundary. Logging is deferred so UART output
        cannot create the timing event being measured. This observes port 5000
        traffic only; Wi-Fi management frames and unrelated UDP ports remain
        outside this application-level trace.


config FACTORY_FLASH_GUARD_DIAGNOSTICS
    bool "Trace main esp_flash cache-disabled windows"
    default n
    help
        Temporary qualification diagnostic. Wraps the main flash chip's
        esp_flash OS start/end callbacks after NVS initialization. This is the
        actual path used by NVS in ESP-IDF v6.0. IRAM/DRAM-only timestamps are
        retained while cache is disabled and dumped only after the countdown.

config FACTORY_FLASH_GUARD_EVENT_THRESHOLD_US
    int "Flash-guard event retention threshold (microseconds)"
    range 0 1000000
    default 0
    depends on FACTORY_FLASH_GUARD_DIAGNOSTICS
    help
        Cache-disabled windows at or above this duration are retained in a 256-entry
        RAM ring for post-run correlation with callback_lateness_us and Analyzer
        COMMIT timestamps. v6.23.8 uses 0 us so every observed window is retained.


config FACTORY_TIMING_PROBE_OUTPUT
    bool "Drive diagnostic blocking-window probe GPIO"
    default n
    depends on FACTORY_FLASH_GUARD_DIAGNOSTICS && IDF_TARGET_ESP32
    help
        Diagnostic-only output. The probe is HIGH during every wrapped esp_flash
        cache-off window and during the v6.23.8 injected cache/critical-section
        controls. Connect ESP02 GPIO32 to Analyzer_v8 channel 4 (normally labeled
        ESP02_SQW) for this test. ESP02 START-edge diagnostics are disabled in
        this diagnostic profile because GPIO32 is dedicated to this probe. Do not use in production.

config FACTORY_TIMING_PROBE_GPIO
    int "Blocking-window probe GPIO"
    range 0 33
    default 32
    depends on FACTORY_TIMING_PROBE_OUTPUT
    help
        GPIO32 is dedicated to the v6.23.8 ESP02 blocking-window probe. GPIO0..31
        use GPIO_OUT_W1TS/W1TC; GPIO32..33 use GPIO_OUT1_W1TS/W1TC so the probe
        remains IRAM/cache-safe. The ESP02 START-edge marker is disabled to avoid
        a GPIO32 conflict.

config FACTORY_TIMING_MECHANISM_TEST
    bool "Inject deterministic cache-off / CPU critical-section controls"
    default n
    depends on FACTORY_TIMING_PROBE_OUTPUT && IDF_TARGET_ESP32
    help
        v6.23.8 diagnostic-only mechanism test on ESP02. During a RUNNING countdown:
          boundary 30: 1000 us cache-off window centered on the edge
          boundary 60: 300 us private critical section on CPU0, starting 100 us early
          boundary 90: 300 us private critical section on CPU1, starting 100 us early
        The protected interval is visible on the timing-probe GPIO. This is a positive
        control for the Analyzer and ISR-lateness telemetry; never enable in production.


config FACTORY_CPU0_LATENCY_MONITOR
    bool "Enable fleet CPU0 GPTimer interrupt-latency monitor"
    default y if IDF_TARGET_ESP32
    depends on IDF_TARGET_ESP32
    help
        v6.23.15 fleet monitor. A free-running GPTimer alarm runs on CPU0 at 4 kHz at
        the same configured interrupt level as the ISR-dispatch esp_timer
        COMMIT callback. It measures ISR-entry lateness from hardware count_value - alarm_value,
        counts skipped 250 us periods, retains excursions above the configured
        threshold, and exposes compact per-run summary fields through STATUS.
        Optional task/ISR canaries are separately gated and default off; the
        fleet profiles generate no canary or GPIO diagnostic pulse.

config FACTORY_CPU0_LATENCY_PERIOD_US
    int "CPU0 latency sample period (microseconds)"
    range 100 10000
    default 251
    depends on FACTORY_CPU0_LATENCY_MONITOR

config FACTORY_CPU0_LATENCY_THRESHOLD_US
    int "CPU0 latency event threshold (microseconds)"
    range 1 10000
    default 50
    depends on FACTORY_CPU0_LATENCY_MONITOR

config FACTORY_CPU0_LATENCY_TASK_CANARY
    bool "Enable task-held critical-section telemetry canary"
    default n
    depends on FACTORY_CPU0_LATENCY_MONITOR
    help
        Validation only. A CPU0 task named lat_canary enters a private critical
        section across one configured display COMMIT boundary. This proves the
        complete path from the 4 kHz monitor through STATUS encoding and the
        Windows health CSV. Leave disabled in fleet/production builds.

config FACTORY_CPU0_LATENCY_TASK_CANARY_MIDSECOND
    bool "Schedule task canary from RUN begin instead of across COMMIT"
    default n
    depends on FACTORY_CPU0_LATENCY_TASK_CANARY
    help
        Validation only. When enabled, schedule the task critical section at a
        fixed local-time offset after RUN begins. This is used to validate the
        GPTimer lateness arithmetic without intentionally delaying COMMIT.

config FACTORY_CPU0_LATENCY_TASK_CANARY_AFTER_RUN_US
    int "Task canary offset after RUN begin (microseconds)"
    range 1000000 600000000
    default 10500000
    depends on FACTORY_CPU0_LATENCY_TASK_CANARY_MIDSECOND

config FACTORY_CPU0_LATENCY_CANARY_BOUNDARY
    int "Task canary COMMIT boundary"
    range 2 600
    default 10
    depends on FACTORY_CPU0_LATENCY_TASK_CANARY && !FACTORY_CPU0_LATENCY_TASK_CANARY_MIDSECOND

config FACTORY_CPU0_LATENCY_CANARY_LEAD_US
    int "Task canary start lead before COMMIT (microseconds)"
    range 50 2000
    default 150
    depends on FACTORY_CPU0_LATENCY_TASK_CANARY && !FACTORY_CPU0_LATENCY_TASK_CANARY_MIDSECOND

config FACTORY_CPU0_LATENCY_CANARY_HOLD_US
    int "Task canary critical-section duration (microseconds)"
    range 300 5000
    default 600
    depends on FACTORY_CPU0_LATENCY_TASK_CANARY

config FACTORY_CPU0_LATENCY_ISR_CANARY
    bool "Enable same-level ISR canary"
    default n
    depends on FACTORY_CPU0_LATENCY_MONITOR
    help
        Diagnostic-only mechanism control retained from v6.23.10. An ISR-dispatch
        esp_timer callback busy-waits once during RUNNING so the monitor's
        same-level ISR signature can be revalidated when needed. Fleet profiles
        leave this disabled.

config FACTORY_CPU0_LATENCY_ISR_CANARY_AFTER_RUN_US
    int "Same-level ISR canary offset after RUN begin (microseconds)"
    range 1000000 600000000
    default 16500000
    depends on FACTORY_CPU0_LATENCY_ISR_CANARY

config FACTORY_CPU0_LATENCY_ISR_CANARY_HOLD_US
    int "Same-level ISR canary duration (microseconds)"
    range 300 5000
    default 500
    depends on FACTORY_CPU0_LATENCY_ISR_CANARY

config FACTORY_ANALYZER_PRESENTATION_OFFSET_US
    int "Diagnostic presentation offset for Analyzer separation (microseconds)"
    range 0 1000
    default 0
    depends on IDF_TARGET_ESP32
    help
        Adds a diagnostic-only offset to GPIO33 presentation deadlines while
        leaving TimerTask/master START time unchanged. Set ESP02 to +50 us in
        Analyzer runs so the two COMMIT edges do not enter the analyzer's roughly
        5-10 us close-edge distortion zone.

config FACTORY_POST_RUN_TIMING_DUMP
    bool "Enable paced asynchronous post-run timing dump"
    default n
    help
        Diagnostic builds only. Copies the buffered timing traces at countdown
        completion and dumps them from a separate low-priority CPU0 task with a
        one-tick pause between records. The UDP CommandTask never performs the
        multi-second UART dump. Leave disabled in production.

config FACTORY_PER_SECOND_STATE_CHANGE_STATUS
    bool "Send STATE_CHANGE status on every RUNNING second (legacy/diagnostic)"
    default n
    help
        Legacy/diagnostic option. Production v6.20 keeps this disabled so a RUNNING
        countdown does not emit one unsolicited application status packet per second.
        Explicit STATUS_REQUEST replies and state-transition telemetry remain active.

config FACTORY_SUPPRESS_RUNNING_HEARTBEAT
    bool "Keep RUNNING countdown application-status traffic silent"
    default y
    help
        Production v6.20 behavior. Suppresses the normal two-second unsolicited
        heartbeat while the timer is RUNNING before Wi-Fi queries, RTC reads,
        status formatting, or sendto occur. Explicit STATUS_REQUEST replies,
        STARTED/FINISHED telemetry, RESET, and command reception remain active.
        Heartbeat cadence bookkeeping still advances while suppressed.

endmenu

menu "Factory HUB75 countdown display"

config FACTORY_DISPLAY_EDGE_DIAGNOSTICS
    bool "Enable display presentation-commit diagnostic GPIO"
    default y
    depends on FACTORY_DISPLAY_TEST
    help
        Validation timing output. It starts low when armed, toggles immediately
        after the START frame flip/commit, and toggles again after every later
        one-second presentation commit including 00:00. Put the corresponding
        GPIO from two devices on the analyzer to measure second-by-second visual
        commit spread. This is a software commit marker, not an optical sensor.

config FACTORY_DISPLAY_EDGE_GPIO
    int "Display presentation-commit diagnostic GPIO"
    range 0 48
    default 33 if IDF_TARGET_ESP32
    default 14 if IDF_TARGET_ESP32S3
    default 33
    depends on FACTORY_DISPLAY_EDGE_DIAGNOSTICS
    help
        GPIO connected to the analyzer for presentation-commit toggles. The
        current defaults are free in the validated panel pin maps: GPIO33 on
        classic ESP32 and GPIO14 on ESP32-S3. Recheck if board wiring changes.

config FACTORY_DISPLAY_REFRESH_EDGE_DIAGNOSTICS
    bool "Enable refresh-side frame-adoption diagnostic GPIO"
    default y if IDF_TARGET_ESP32
    default n
    depends on FACTORY_DISPLAY_EDGE_DIAGNOSTICS && IDF_TARGET_ESP32
    help
        Classic ESP32 validation output. The core-1 HUB75 refresh loop toggles
        this GPIO at the exact complete-scan boundary where a pending frame is
        adopted as active. This measures logical publish-to-visible adoption.

config FACTORY_DISPLAY_REFRESH_EDGE_GPIO
    int "Refresh-side frame-adoption diagnostic GPIO"
    range 0 33
    default 16
    depends on FACTORY_DISPLAY_REFRESH_EDGE_DIAGNOSTICS
    help
        GPIO connected to a spare analyzer channel. GPIO16 is free in the
        validated classic ESP32 P5 + DS3231 wiring.

config FACTORY_DISPLAY_TEST
    bool "Enable 64x32 HUB75 visual countdown test"
    default y
    help
        Enables one 64x32 P5 panel per timer. The panel shows the Bobcat logo
        while idle/armed, changes to a red MM:SS countdown exactly at the local
        START deadline, decrements once per second, and shows red 00:00 when finished.

config FACTORY_DISPLAY_BRIGHTNESS
    int "Countdown display brightness (0-255)"
    range 1 255
    default 128
    depends on FACTORY_DISPLAY_TEST
    help
        S3 uses this value directly. Classic ESP32 maps it to 1-100 percent OE duty.

endmenu
```
